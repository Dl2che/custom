## config/boards/shields/lily58/Kconfig.defconfig
```kconfig
if SHIELD_LILY

config ZMK_KEYBOARD_NAME
    default "lily"

config ZMK_SPLIT_ROLE_CENTRAL
    default y

endif

if SHIELD_LILY_LEFT || SHIELD_LILY_RIGHT

config ZMK_SPLIT
    default y

endif
```
